## main/Kconfig.projbuild
```kconfig
menu "Alexa config"

menu "Wifi Configuration"

config WIFI_SSID
    string "WiFi SSID"
	default "myssid"
	help
		SSID (network name) to connect to.

config WIFI_PASSWORD
    string "WiFi Password"
	default "myssid"
	help
		WiFi password (WPA or WPA2) to use.

		Can be left blank if the network has no security set.
endmenu


choice
    prompt "Audio Output"
    default I2S
    help
        This option selects the audio output.

    config AUDIO_OUTPUT_MODE_I2S
        bool "Generic I2S"
    config AUDIO_OUTPUT_MODE_I2S_MERUS
        bool "Merus Audio I2S"
    config AUDIO_OUTPUT_MODE_DAC_BUILT_IN
        bool "Built-In DAC"
    config AUDIO_OUTPUT_MODE_PDM
        bool "PDM"
endchoice

config AUDIO_OUTPUT_MODE
    int
    default 0 if AUDIO_OUTPUT_MODE_I2S
    default 1 if AUDIO_OUTPUT_MODE_I2S_MERUS
    default 2 if AUDIO_OUTPUT_MODE_DAC_BUILT_IN
    default 3 if AUDIO_OUTPUT_MODE_PDM

choice
    prompt "API Endpoint"
    default EU
    help
        Select API endpoint URL.

    config ALEXA_ENDPOINT_EU
        bool "EU"
    config ALEXA_ENDPOINT_US
        bool "US"
endchoice

config ALEXA_ENDPOINT
    string
    default "https://avs-alexa-na.amazon.com" if ALEXA_ENDPOINT_US
    default "https://avs-alexa-eu.amazon.com" if ALEXA_ENDPOINT_EU


choice
    prompt "Language"
    default ALEXA_LOCALE_EN_GB
    help
        Select locale.

    config ALEXA_LOCALE_EN_US
        bool "en-US"
    config ALEXA_LOCALE_EN_GB
        bool "en-GB"
    config ALEXA_LOCALE_DE_DE
        bool "de-DE"
endchoice

config ALEXA_LOCALE
    string
    default "en-US" if ALEXA_LOCALE_EN_US
    default "en-GB" if ALEXA_LOCALE_EN_GB
    default "de-DE" if ALEXA_LOCALE_DE_DE

config ALEXA_AUTH_REFRESH_TOKEN
	string "Authentication Token"
	help
		Generate a token at https://alexa.boeckling.net/ and paste it here.

endmenu
```
